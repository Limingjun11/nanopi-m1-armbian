// ST7735R SPI TFT via fbtft (template: adjust the GPIOs to your wiring)
/dts-v1/;
/plugin/;

/ {
	compatible = "allwinner,sun8i-h3";

	fragment@0 {
		target = <&spi0>;
		__overlay__ {
			status = "okay";
			#address-cells = <1>;
			#size-cells = <0>;

			display@0 {
				compatible = "sitronix,st7735r";
				reg = <0>;
				spi-max-frequency = <32000000>;
				rotate = <90>;
				fps = <25>;
				buswidth = <8>;
				/* TODO: reset / dc pins, format <&pio bank pin flags> */
				reset-gpios = <&pio 0 10 1>;	/* PA10, active low  */
				dc-gpios    = <&pio 0 9 0>;	/* PA9,  active high */
				debug = <0>;
			};
		};
	};
};
